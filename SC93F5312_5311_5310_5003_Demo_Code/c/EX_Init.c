#include "H/Function_Init.H"

void EX_Init(void);
uchar INT0_flag = 0x00;

/*****************************************************
*函数名称：void EX_Test(void)
*函数功能：外部中断测试
*入口参数：void
*出口参数：void
*****************************************************/
void EX_Test(void)
{
    EX_Init();
    while(1)
    {
    }
}

/*****************************************************
*函数名称：void EX_Init(void)
*函数功能：外部中断初始化
*入口参数：void
*出口参数：void
*****************************************************/
void EX_Init(void)
{	
	//配置中断口INT00、INT01、INT13
	P1CON &= 0XFC;     //中断IO口设置为高阻输入
	P1PH  |= 0x03;     //中断IO口设置为高阻带上拉
	P2CON &= 0X7F;     //中断IO口设置为高阻输入
	P2PH  |= 0x80;     //中断IO口设置为高阻带上拉
 
	//配置INT00/INT01下降沿中断、INT13上升沿中断
    //下降沿设置	
	INT0F = 0X03 ;    //0000 xxxx  0关闭 1使能
	INT1F = 0X00 ;    //0000 xxxx  0关闭 1使能

    //上升沿设置	
	INT0R = 0X00 ;    //0000 xxxx  0关闭 1使能 
	INT1R = 0X08 ;    //0000 xxxx  0关闭 1使能
	
	//外部中断优先级设置
	IE  |= 0x05;	//0000 0x0x
	IP  |= 0X00;
	EA = 1;
}

/*****************************************************
*函数名称：void EX0/1/2() interrupt	0/2/10
*函数功能：外部中断函数
*入口参数：void
*出口参数：void
*****************************************************/
void EX0() interrupt	0
{
    P25 = ~P25;
    if(P10 == 0)
	{
		INT0_flag = 0x10; //INT24产生中断
	}
	if(P11 == 0)
	{
		INT0_flag = 0x20; //INT25产生中断
	}
}

void EX1() interrupt	2
{
    P26 = ~P26;   
}

